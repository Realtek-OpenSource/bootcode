## arch/arm/cpu/armv8/Kconfig
```kconfig
if ARM64

config ARMV8_MULTIENTRY
        boolean "Enable multiple CPUs to enter into U-boot"

endif

config RTK_XEN_MONITOR_SUPPORT
	boolean "RTK XEN-Monitor mode support"
	depends on TARGET_RTD1295
	default n
	help
	  REALTEK XEN EL3 Monitor mode support. Turn on this
	  configuration so XEN could perform initialization
	  for the 1st time when startup.
```

## board/realtek/Kconfig
```kconfig
menu "RealTek 1295 Board Type"
	depends on TARGET_RTD1295

choice
	prompt "Board Type Select"

config BOARD_FPGA
	bool "RTD1295 FPGA Board"

config BOARD_QA
	bool "RTD1295 QA Board"

endchoice
endmenu

if TARGET_RTD1295

config SYS_VENDOR
	default "realtek"

config SYS_SOC
	default "rtd1295"

config SYS_BOARD
	default "1295_fpga" if BOARD_FPGA
	default "1295_qa" if BOARD_QA

config SYS_CONFIG_NAME
	default "rtd1295_fpga" if BOARD_FPGA
	default "rtd1295_qa" if BOARD_QA


endif #TARGET_RTD1295
```
